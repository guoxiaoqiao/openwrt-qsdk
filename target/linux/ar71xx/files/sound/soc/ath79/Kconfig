## target/linux/ar71xx/files/sound/soc/ath79/Kconfig
```kconfig
config SND_ATH79_SOC
	tristate "SoC Audio for ath79"
	depends on SOC_AR934X
	help
	  Say Y or M if you want to add support for ath79 platforms
	  You will also need to select the board in the options below.

config SND_ATH79_SOC_I2S
	tristate

config SND_ATH79_SOC_CODEC
	tristate

config SND_ATH79_SOC_DB120
	tristate "SoC Audio support for QCA Reference design DB120"
	depends on SND_ATH79_SOC
	select SND_ATH79_SOC_I2S
	select SND_ATH79_SOC_CODEC
	help
	  Say Y if you want to add support for SoC audio on DB120
	  Qualcomm-Atheros reference design. This option enables the
	  DB12x machine support, ath79 PCM engine, I2S interface and internal
	  codec.
```

## target/linux/ar71xx/files/sound/soc/qca/Kconfig
```kconfig
config SND_WASP_SOC
	tristate "SoC Audio for the QCA Wasp chip"
	depends on SOC_AR934X
	help
	  Say Y or M if you want to add support for Wasp Audio DMA engine
	  You will also need to select the board and the interface below.
	  This option enable the platform support

config SND_WASP_SOC_I2S
	tristate "SoC Audio for the QCA Wasp chip - I2s support"
	depends on SND_WASP_SOC
	help
	  Say Y or M if you want to add support for Wasp Audio I2s interface
	  This option enables the interface support

config SND_WASP_SOC_DB120
	tristate "SoC Audio support for QCA Reference design DB120"
	depends on SND_WASP_SOC
	select SND_SOC_SPDIF
	help
	  Say Y if you want to add support for SoC audio on DB120
	  Qualcomm-Atheros reference design. This option enables the
	  DB12x machine support.
```

## target/linux/ipq806x/image/sysupgrade-ubi-mbn.its
```
/dts-v1/;

/ {
        description = "IPQ8066/NAND Sysupgrade image";
        images {

                ubi {
                        description = "openwrt-ipq806x-ubi-mbn-root.img";
                        data = /incbin/("./openwrt-ipq806x-ubi-mbn-root.img");
                        type = "firmware";
                        arch = "arm";
                        compression = "none";
                        hash@1 { algo = "crc32"; };
                };

        };
};
```

## target/linux/ubicom32/image/Config.in
```kconfig
config IDENTITY_STRING
	string "Application Identity String (up to 31 chars)"
	depends TARGET_ubicom32
	default "Unknown - BOARD"
	help

	  This is used to detect compatibility between the application and
	  upgrade images.  The IDENTITY_STRING must match in order for an
	  upgrade image to be accepted for upgrade.

	  For example
	   "ProductX rev1.1"
	  would be a good IDENTITY_STRING

menu "gdbloader"
	depends TARGET_ubicom32
	config GDBLOADER_DIR
		string
		prompt "GDBLoader directory"
		default "$(TOPDIR)/proprietary/gdbloader"

endmenu

menu "ultra"
	depends TARGET_ubicom32
	config ULTRA_DIR
		string
		prompt "Ultra directory"
		default "$(TOPDIR)/proprietary/ultra"

	source target/linux/ubicom32/image/Config.in.ultra.boards
	source target/linux/ubicom32/image/Config.in.ultra.lpj

endmenu
```
